## components/app_ble/Kconfig
```kconfig
menu "Application BLE Module"
    config APP_BLE
        bool "Enable BLE Driver"
        default false

    config APP_BLE_DEVICE_NAME
        depends on APP_BLE
        string "Device name"
        default "APP-BLE-Server"
    
    config APP_BLE_MAX_CONNECTIONS
        depends on APP_BLE
        int "Max number of connections"
        range 1 5
        default 3

    choice APP_BLE_DRIVER_TYPE
        depends on APP_BLE
        prompt "NimBLE or BlueDroid"
        default APP_BLE_DRIVER_NIMBLE

        config APP_BLE_DRIVER_NIMBLE
        bool "Select NimBLE driver"
    
        config APP_BLE_DRIVER_BLUEDROID
        bool "Select BlueDroid driver"
    endchoice 
        
        
    module = ABLE
    module-str = ABLE
    rsource "../../main/Kconfig.log_level"
endmenu
```

## components/app_sntp/Kconfig
```kconfig
menu "Application SNTP Module"

    config URL
        depends on WIFI && SNTP
        string "SNTP Server URL"
        default "pool.ntp.org"


    module = SNTP
    module-str = SNTP
    rsource "../../main/Kconfig.log_level"

endmenu
```

## components/app_spi/Kconfig
```kconfig
menu "Application SPI Module"
    config APP_SPI_CLOCK_MHZ
        int "SPI Clock frequency in MHz"
        default 8

    module = SPI
    module-str = SPI
    rsource "../../main/Kconfig.log_level"
endmenu
```

## components/app_spiflash/Kconfig
```kconfig
menu "Application SPI Flash Module"

    config SPI_CS_PIN
        int "SPI Flash CS Pin nummber"
        default 25

    config SPI_SCK_PIN
        int "SPI Flash SCK Pin nummber"
        default 26
        
    config SPI_MOSI_PIN
        int "SPI Flash MOSI Pin nummber"
        default 33
        
    config SPI_MISO_PIN
        int "SPI Flash MISO Pin nummber"
        default 35

    config SPI_CHIPERASE_TIMEOUT_MS
        int "SPI Chip erase timeout in ms"
        default 60000
        
    module = SPIFLASH
    module-str = SPIFLASH
    rsource "../../main/Kconfig.log_level"
endmenu
```

## components/app_wifi/Kconfig
```kconfig
menu "Application Wifi Module"

    config SSID
        depends on WIFI
        string "WiFi SSID to connect"
        default ""

    config PASSWORD
        depends on WIFI
        string "WiFi password to connect"
        default ""
        
    module = WIFI
    module-str = WIFI
    rsource "../../main/Kconfig.log_level"
endmenu
```

## components/button_events/Kconfig
```kconfig
menu "Application buttons event"
    config DEFAULT_BTN_HOLD_TIME_MS
        int "Time in ms to detect button hold"
        default 1000000

    choice BTN_ACTIVE_LEVEL
        bool "Select active level for buttons"
        default BTN_ACTIVE_LOW_LEVEL

        config BTN_ACTIVE_HIGHT_LEVEL
            bool "Active level is HIGHT"

        config BTN_ACTIVE_LOW_LEVEL
            bool "Active level is LOW"
        
    endchoice

    module = BTN
    module-str = BTN
    rsource "../../main/Kconfig.log_level"
endmenu
```

## main/Kconfig.projbuild
```kconfig
mainmenu "Test WiFi application"

menu "Test WiFi application"
    config SNTP
        depends on WIFI
        bool "Application SNTP Module activate"

    config WIFI
        bool "Application WiFi Module activate"
endmenu
```

## test/main/Kconfig.projbuild
```kconfig
menu "Application Test components select"

    config APP_TEST_ASPI
        bool "Test SPI component"
        default y
        
    config APP_TEST_ASPIFLASH
        bool "Test SPI Flash component"
        default n
endmenu
```

## test/sdkconfig.defaults
```kconfig
CONFIG_ESP_TASK_WDT_EN=n
CONFIG_WIFI=n
CONFIG_SNTP=n
CONFIG_APP_BLE=n
CONFIG_UNITY_ENABLE_COLOR=y
CONFIG_SPIFLASH_LOG_LEVEL=4
```
